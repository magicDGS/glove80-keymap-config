## config/west.yml
```yaml
manifest:
  remotes:
    - name: moergo-sc
      url-base: https://github.com/moergo-sc
    - name: joelspadin
      url-base: https://github.com/joelspadin
    - name: urob
      url-base: https://github.com/urob
    - name: magicDGS
      url-base: https://github.com/magicDGS

  projects:
    - name: zmk
      remote: moergo-sc
      revision: v25.01
      import: app/west.yml
    - name: zmk-locales
      remote: joelspadin
      revision: v1.1.0
      path: modules/locales
    - name: zmk-helpers
      remote: urob
      revision: v0.1
      path: modules/zmk-helpers
    - name: zmk-keymap-utils
      remote: magicDGS
      revision: v0.3
      path: modules/zmk-keymap-utils

  self:
    path: config
```
