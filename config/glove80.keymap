/* magicDGS's Glove80 keymap definition */

#include <behaviors.dtsi>
/* Include all behavior includes needed */
#include <dt-bindings/zmk/outputs.h>
#include <dt-bindings/zmk/keys.h>
#include <dt-bindings/zmk/bt.h>
#include <dt-bindings/zmk/rgb.h>

/* Layer names to simplify configuration */
#define DEF 0
#define NAV 1
#define NUM 2
#define FN 3
#define SYM 4
#define MOUSE 5
#define LOWER 6
#define MAGIC 7

/* Include the configuration header, containing
 * - Locale configuratin
 * - OS-configuration
 * - Key labels 
 */
#include "config.h"
// TODO: good candidate for zmk-keymap-utils to simplify configuration of mouse
#include "mouse_config.h"

/* Default glove80 system configuration, including key-positions */
#include "includes/glove80/system.dtsi"
// import zmk-keymap-utils modules with WINDOWS configuration
#include <zmk-keymap-utils/init.h>
// select/extend behaviors
#include <zmk-keymap-utils/select_word.dtsi>
// urob's timeless-hrm - TODO: move to the keymap-utils module
#include <zmk-keymap-utils/hrm/timeless.dtsi>

// include Sunaku's specific behavior
#include "includes/glove80/sunaku.dtsi"
// custom zmk-helpers relying functionality (on this repo)
#include "includes/es-undead.dtsi"

// define standard keys and key-groups (following Urob's standard)
#include <zmk-helpers/key-labels/glove80.h>

// create timeless-hrm
MAKE_TIMELESS_HRM(hm_l, &kp, &kp, KEYS_R THUMBS) // &hm_l (left-hand HRM)
MAKE_TIMELESS_HRM(hm_r, &kp, &kp, KEYS_L THUMBS) // &hm_r (right-hand HRM)

// include our combos (implemented with zmk-helpers and zmk-keymap-utils)
#include "includes/combos.dtsi"

// simplify coding with XXX representing none
#define XXX &none

/* Automatically generated keymap */
GLV80_LAYER(Base,
// ╭───────────────┬────────────────┬────────────────┬─────────────────┬─────────────────╮                             ╭─────────────────┬─────────────────┬────────────────┬──────────────────────┬─────────────────╮
     &kp F1          &kp F2           &kp F3           &kp F4            &kp F5                                          &kp F6            &kp F7            &kp F8           &kp F9                 &kp F10
// ├───────────────┼────────────────┼────────────────┼─────────────────┼─────────────────┼────────────╮   ╭────────────┼─────────────────┼─────────────────┼────────────────┼──────────────────────┼─────────────────┤
     &kp ES_IEXCL    &kp ES_N1        &kp ES_N2        &kp ES_N3         &kp ES_N4         &kp ES_N5        &kp ES_N6    &kp ES_N7         &kp ES_N8         &kp ES_N9        &kp ES_N0              &kp ES_SQT
// ├───────────────┼────────────────┼────────────────┼─────────────────┼─────────────────┼────────────┤   ├────────────┼─────────────────┼─────────────────┼────────────────┼──────────────────────┼─────────────────┤
     &kp ES_ORDM     &kp ES_Q         &hm_l RALT ES_W  &kp ES_E          &kp ES_R          &kp ES_T         &kp ES_Y     &kp ES_U          &kp ES_I          &hm_r RALT ES_O  &kp ES_P               &kp ES_C_CEDILLA
// ├───────────────┼────────────────┼────────────────┼─────────────────┼─────────────────┼────────────┤   ├────────────┼─────────────────┼─────────────────┼────────────────┼──────────────────────┼─────────────────┤
     &caps_word      &hm_l LGUI ES_A  &hm_l LALT ES_S  &hm_l LSHFT ES_D  &hm_l LCTRL ES_F  &kp ES_G         &kp ES_H     &hm_r RCTRL ES_J  &hm_r RSHFT ES_K  &hm_r LALT ES_L  &hm_r RGUI ES_N_TILDE  &kp ES_ACUTE
// ├───────────────┼────────────────┼────────────────┼─────────────────┼─────────────────┼────────────┤   ├────────────┼─────────────────┼─────────────────┼────────────────┼──────────────────────┼─────────────────┤
     &sk LSHFT       &kp ES_Z         &kp ES_X         &kp ES_C          &kp ES_V          &kp ES_B     ,   &kp ES_N     &kp ES_M          &kp ES_COMMA      &kp ES_DOT       &kp ES_MINUS           &sk RSHFT
// ├───────────────┼────────────────┼────────────────┼─────────────────┼─────────────────┼────────────╯   ╰────────────┼─────────────────┼─────────────────┼────────────────┼──────────────────────┼─────────────────┤
     &magic MAGIC 0  &kp LCTRL         &kp LALT         &kp LGUI          &kp ES_LT                     ,                &kp ES_GRAVE      &kp ES_PLUS       &kp RALT        &kp RCTRL               &magic MAGIC 0
// ╰───────────────┴────────────────┴────────────────┴─────────────────┴─────────────────╯                             ╰─────────────────┴─────────────────┴────────────────┴──────────────────────┴─────────────────╯
                                                                                                        ,
//                                                   ╭────────────────┬───────────────┬────────────╮         ╭────────────┬─────────────────┬─────────────────╮
                                                       &thumb FN ESC    &kp UP          &kp DOWN               &kp LEFT     &kp RIGHT         &kp RET
/*                                                   ├────────────────┼───────────────┼────────────┤ */ , /* ├────────────┼─────────────────┼─────────────────┤ */
                                                       &thumb NAV BSPC  &thumb NUM DEL  &lower                 &lower       &thumb MOUSE TAB  &thumb SYM SPACE
//                                                   ╰────────────────┴───────────────┴────────────╯         ╰────────────┴─────────────────┴─────────────────╯
)

GLV80_LAYER(Nav,
// ╭──────────────────┬───────────────┬─────────────┬─────────────┬───────────────╮                             ╭────────────┬───────────────┬───────────────┬──────────────────┬──────────────────╮
     &none              &none           &none         &none         &none                                         &none        &none           &none           &none              &none
// ├──────────────────┼───────────────┼─────────────┼─────────────┼───────────────┼────────────╮   ╭────────────┼────────────┼───────────────┼───────────────┼──────────────────┼──────────────────┤
     &kp ESC            &kp RET         &kp SPACE     &kp TAB       &kp DEL         &kp INS          &kp INS      &kp DEL      &kp TAB         &kp SPACE       &kp RET            &kp ESC
// ├──────────────────┼───────────────┼─────────────┼─────────────┼───────────────┼────────────┤   ├────────────┼────────────┼───────────────┼───────────────┼──────────────────┼──────────────────┤
     &kp _B_SEARCH_BAR  &sk LSHFT       &kp _REDO     &kp _UNDO     &kp BSPC        &kp _CUT         &kp _CUT     &kp BSPC     &kp _UNDO       &kp _REDO       &sk RSHFT          &kp _B_SEARCH_BAR
// ├──────────────────┼───────────────┼─────────────┼─────────────┼───────────────┼────────────┤   ├────────────┼────────────┼───────────────┼───────────────┼──────────────────┼──────────────────┤
     &kp _B_URL_BAR     &kp LGUI        &kp LALT      &kp LSHFT     &kp LCTRL       &kp _COPY        &kp _COPY    &kp LEFT     &kp UP          &kp DOWN        &kp RIGHT          &kp _B_URL_BAR
// ├──────────────────┼───────────────┼─────────────┼─────────────┼───────────────┼────────────┤   ├────────────┼────────────┼───────────────┼───────────────┼──────────────────┼──────────────────┤
     &kp _B_DOWNLOADS   &select_all     &select_line  &select_word  &kp _FIND       &kp _PASTE   ,   &kp _PASTE   &kp _HOME    &kp PG_UP       &kp PG_DN       &kp _END           &kp _B_DOWNLOADS
// ├──────────────────┼───────────────┼─────────────┼─────────────┼───────────────┼────────────╯   ╰────────────┼────────────┼───────────────┼───────────────┼──────────────────┼──────────────────┤
     &kp _FIND_REPLACE  &kp _FIND_PREV  &extend_line  &extend_word  &kp _FIND_NEXT               ,                &kp _FIND    &kp _FIND_PREV  &kp _FIND_NEXT  &kp _FIND_REPLACE  &kp _EMOJI
// ╰──────────────────┴───────────────┴─────────────┴─────────────┴───────────────╯                             ╰────────────┴───────────────┴───────────────┴──────────────────┴──────────────────╯
                                                                                                 ,
//                                           ╭────────────────┬────────────────┬────────────╮         ╭─────────────┬─────────────┬─────────────╮
                                               &mod_tab _A_TAB  &mod_tab _G_TAB  &kp TAB                &select_none  &extend_line  &extend_word 
/*                                           ├────────────────┼────────────────┼────────────┤ */ , /* ├─────────────┼─────────────┼─────────────┤ */
                                               &none            &mod_tab LCTRL   &tog NAV               &select_all   &select_line  &select_word
//                                           ╰────────────────┴────────────────┴────────────╯         ╰─────────────┴─────────────┴─────────────╯
)

GLV80_LAYER(Num,
// ╭────────────┬────────────┬─────────────┬─────────────┬────────────╮                                  ╭─────────────────┬────────────┬────────────┬─────────────┬────────────╮
     &none        &none        &none         &none         &none                                           &none             &none        &none        &none         &none
// ├────────────┼────────────┼─────────────┼─────────────┼────────────┼────────────╮   ╭─────────────────┼─────────────────┼────────────┼────────────┼─────────────┼────────────┤
     &kp ESC      &kp RET      &kp SPACE     &kp TAB       &kp DEL      &kp INS          &ES_TILDE_UNDEAD  &ES_CARET_UNDEAD  &kp ES_HASH  &kp ES_DLLR  &kp ES_EXCL   &none
// ├────────────┼────────────┼─────────────┼─────────────┼────────────┼────────────┤   ├─────────────────┼─────────────────┼────────────┼────────────┼─────────────┼────────────┤
     &none        &sk LSHFT    &kp _REDO     &kp _UNDO     &kp BSPC     &none            &kp ES_PRCNT      &kp ES_N7         &kp ES_N8    &kp ES_N9    &kp ES_COLON  &none
// ├────────────┼────────────┼─────────────┼─────────────┼────────────┼────────────┤   ├─────────────────┼─────────────────┼────────────┼────────────┼─────────────┼────────────┤
     &kp KP_NUM   &kp LGUI     &kp LALT      &kp LSHFT     &kp LCTRL    &none            &kp KP_PLUS       &kp ES_N4         &kp ES_N5    &kp ES_N6    &kp KP_MINUS  &none
// ├────────────┼────────────┼─────────────┼─────────────┼────────────┼────────────┤   ├─────────────────┼─────────────────┼────────────┼────────────┼─────────────┼────────────┤
     &none        &select_all  &select_line  &select_word  &kp _FIND    &none        ,   &kp KP_MULTIPLY   &kp ES_N1         &kp ES_N2    &kp ES_N3    &kp KP_SLASH  &none
// ├────────────┼────────────┼─────────────┼─────────────┼────────────┼────────────╯   ╰─────────────────┼─────────────────┼────────────┼────────────┼─────────────┼────────────┤
     &none        &none        &extend_line  &extend_word  &none                     ,                     &none             &none        &none        &none         &kp ES_AT
// ╰────────────┴────────────┴─────────────┴─────────────┴────────────╯                                  ╰─────────────────┴────────────┴────────────┴─────────────┴────────────╯
                                                                                     ,
//                                       ╭────────────┬────────────┬────────────╮         ╭─────────────┬────────────┬─────────────╮
                                           &none        &none        &none                  &kp ES_LT     &kp ES_GT    &kp KP_EQUAL 
/*                                       ├────────────┼────────────┼────────────┤ */ , /* ├─────────────┼────────────┼─────────────┤ */
                                           &none        &none        &tog NUM               &kp KP_COMMA  &kp KP_DOT   &kp ES_N0
//                                       ╰────────────┴────────────┴────────────╯         ╰─────────────┴────────────┴─────────────╯
)

GLV80_LAYER(Fn,
// ╭────────────┬────────────┬─────────────┬─────────────┬────────────╮                                  ╭──────────────┬─────────────┬─────────────┬──────────────┬───────────────╮
     &none        &none        &none         &none         &none                                           &none          &none         &none         &none          &none
// ├────────────┼────────────┼─────────────┼─────────────┼────────────┼────────────╮   ╭─────────────────┼──────────────┼─────────────┼─────────────┼──────────────┼───────────────┤
     &kp ESC      &kp RET      &kp SPACE     &kp TAB       &kp DEL      &kp INS          &kp C_MEDIA_HOME  &kp C_PLAY     &kp C_PREV    &kp C_NEXT    &kp C_STOP     &kp C_EJECT
// ├────────────┼────────────┼─────────────┼─────────────┼────────────┼────────────┤   ├─────────────────┼──────────────┼─────────────┼─────────────┼──────────────┼───────────────┤
     &none        &sk LSHFT    &kp _REDO     &kp _UNDO     &kp BSPC     &none            &kp K_CALC        &kp F7         &kp F8        &kp F9        &kp F10        &kp F13
// ├────────────┼────────────┼─────────────┼─────────────┼────────────┼────────────┤   ├─────────────────┼──────────────┼─────────────┼─────────────┼──────────────┼───────────────┤
     &kp CAPS     &kp LGUI     &kp LALT      &kp LSHFT     &kp LCTRL    &none            &kp K_WWW         &kp F4         &kp F5        &kp F6        &kp F11        &kp F14
// ├────────────┼────────────┼─────────────┼─────────────┼────────────┼────────────┤   ├─────────────────┼──────────────┼─────────────┼─────────────┼──────────────┼───────────────┤
     &none        &select_all  &select_line  &select_word  &none        &none        ,   &kp C_AL_FILES    &kp F1         &kp F2        &kp F3        &kp F12        &kp F15
// ├────────────┼────────────┼─────────────┼─────────────┼────────────┼────────────╯   ╰─────────────────┼──────────────┼─────────────┼─────────────┼──────────────┼───────────────┤
     &none        &none        &extend_line  &extend_word  &none                     ,                     &kp C_BRI_MAX  &kp C_BRI_UP  &kp C_BRI_DN  &kp C_BRI_MIN  &kp C_BRI_AUTO
// ╰────────────┴────────────┴─────────────┴─────────────┴────────────╯                                  ╰──────────────┴─────────────┴─────────────┴──────────────┴───────────────╯
                                                                                     ,
//                                       ╭────────────┬────────────┬────────────╮         ╭────────────┬─────────────┬─────────────╮
                                           &none        &none        &none                  &kp C_PREV   &kp C_NEXT    &kp C_PP
/*                                       ├────────────┼────────────┼────────────┤ */ , /* ├────────────┼─────────────┼─────────────┤ */
                                           &none        &none        &tog FN                &kp C_MUTE   &kp C_VOL_DN  &kp C_VOL_UP
//                                       ╰────────────┴────────────┴────────────╯         ╰────────────┴─────────────┴─────────────╯
)

GLV80_LAYER(Sym,
// ╭─────────────────┬─────────────────┬─────────────┬─────────────┬────────────╮                              ╭────────────┬────────────┬────────────┬────────────┬────────────╮
     &none             &none             &none         &none         &none                                       &none        &none        &none        &none        &none
// ├─────────────────┼─────────────────┼─────────────┼─────────────┼────────────┼─────────────╮   ╭────────────┼────────────┼────────────┼────────────┼────────────┼────────────┤
     &none             &ES_GRAVE_UNDEAD  &kp ES_LPAR   &kp ES_RPAR   &kp ES_SEMI  &kp ES_COMMA      &none        &none        &none        &none        &none        &none
// ├─────────────────┼─────────────────┼─────────────┼─────────────┼────────────┼─────────────┤   ├────────────┼────────────┼────────────┼────────────┼────────────┼────────────┤
     &kp ES_EXCL       &kp ES_LBRC       &kp ES_SQT    &kp ES_DQT    &kp ES_RBRC  &kp ES_QMARK      &none        &kp LCTRL    &kp LSHFT    &kp LALT     &kp LGUI     &none
// ├─────────────────┼─────────────────┼─────────────┼─────────────┼────────────┼─────────────┤   ├────────────┼────────────┼────────────┼────────────┼────────────┼────────────┤
     &kp ES_HASH       &ES_CARET_UNDEAD  &kp ES_EQUAL  &kp ES_UNDER  &kp ES_DLLR  &kp ES_STAR       &none        &kp BSPC     &kp TAB      &kp SPACE    &kp RET      &none
// ├─────────────────┼─────────────────┼─────────────┼─────────────┼────────────┼─────────────┤   ├────────────┼────────────┼────────────┼────────────┼────────────┼────────────┤
     &ES_TILDE_UNDEAD  &kp ES_LT         &kp ES_PIPE   &kp ES_MINUS  &kp ES_GT    &kp ES_FSLH   ,   &none        &kp DEL      &kp LS(TAB)  &none        &none        &none
// ├─────────────────┼─────────────────┼─────────────┼─────────────┼────────────┼─────────────╯   ╰────────────┼────────────┼────────────┼────────────┼────────────┼────────────┤
     &kp ES_AT         &kp ES_AMPS       &kp ES_LBKT   &kp ES_RBKT   &kp ES_PLUS                ,                &none        &none        &none        &none        &none        
// ╰─────────────────┴─────────────────┴─────────────┴─────────────┴────────────╯                              ╰────────────┴────────────┴────────────┴────────────┴────────────╯
                                                                                                ,
//                                                ╭─────────────┬─────────────┬────────────╮         ╭────────────┬────────────┬────────────╮
                                                    &kp ES_BSLH   &kp ES_DOT    &kp ES_STAR            &none        &none        &none
/*                                                ├─────────────┼─────────────┼────────────┤ */ , /* ├────────────┼────────────┼────────────┤ */
                                                    &kp ES_PRCNT  &kp ES_COLON  &kp ES_SEMI            &tog SYM     &none        &none
//                                                ╰─────────────┴─────────────┴────────────╯         ╰────────────┴────────────┴────────────╯
)

GLV80_LAYER(Mouse,
// ╭────────────┬────────────────┬────────────────┬───────────────┬────────────────╮                              ╭────────────────┬──────────────┬────────────────┬─────────────────┬────────────╮
     XXX          XXX              XXX              XXX             XXX                                             XXX              XXX            XXX              XXX               XXX
// ├────────────┼────────────────┼────────────────┼───────────────┼─────────────────┼────────────╮   ╭────────────┼────────────────┼──────────────┼────────────────┼─────────────────┼────────────┤
     XXX          XXX              XXX              XXX             XXX               XXX              XXX          &sk LCTRL        &sk LSHFT      &sk LALT         &sk LGUI          XXX
// ├────────────┼────────────────┼────────────────┼───────────────┼─────────────────┼────────────┤   ├────────────┼────────────────┼──────────────┼────────────────┼─────────────────┼────────────┤
     XXX          XXX              &msc _SCRL_LEFT  &mmv MOVE_UP    &msc _SCRL_RIGHT  &kp _CUT         &kp _CUT     &msc _SCRL_LEFT  &msc _SCRL_UP  &msc _SCRL_DOWN  &msc _SCRL_RIGHT  XXX
// ├────────────┼────────────────┼────────────────┼───────────────┼─────────────────┼────────────┤   ├────────────┼────────────────┼──────────────┼────────────────┼─────────────────┼────────────┤
     XXX          &msc _SCRL_UP    &mmv MOVE_LEFT   &mmv MOVE_DOWN  &mmv MOVE_RIGHT   &kp _COPY        &kp _COPY    XXX              XXX            XXX              &kp K_APP         XXX
// ├────────────┼────────────────┼────────────────┼───────────────┼─────────────────┼────────────┤   ├────────────┼────────────────┼──────────────┼────────────────┼─────────────────┼────────────┤
     XXX          &msc _SCRL_DOWN  XXX              XXX             XXX               &kp _PASTE   ,   &kp _PASTE   &mmv MOVE_LEFT   &mmv MOVE_UP   &mmv MOVE_DOWN   &mmv MOVE_RIGHT   XXX
// ├────────────┼────────────────┼────────────────┼───────────────┼─────────────────┼────────────╯   ╰────────────┼────────────────┼──────────────┼────────────────┼─────────────────┼────────────┤
     XXX          XXX              XXX              XXX             XXX                            ,                &mkp LCLK        &mkp RCLK      &mkp MCLK        &mkp MB4          &mkp MB5
// ╰────────────┴────────────────┴────────────────┴───────────────┴─────────────────╯                             ╰────────────────┴──────────────┴────────────────┴─────────────────┴────────────╯
                                                                                                   ,
//                                                     ╭────────────┬────────────┬────────────╮         ╭────────────┬────────────┬────────────╮
                                                         &mkp MCLK    &kp K_APP    &mkp MB5               XXX          XXX          XXX
/*                                                     ├────────────┼────────────┼────────────┤ */ , /* ├────────────┼────────────┼────────────┤ */
                                                         &mkp LCLK    &mkp RCLK    &mkp MB4               &tog MOUSE   XXX          XXX
//                                                     ╰────────────┴────────────┴────────────╯         ╰────────────┴────────────┴────────────╯
)

GLV80_LAYER(Lower,
// ╭─────────────────┬─────────────┬────────────┬────────────┬────────────╮                              ╭────────────┬─────────────┬─────────────┬────────────────┬────────────────╮
     &kp C_BRI_DN      &kp C_BRI_UP  &kp C_PREV   &kp C_NEXT   &kp C_PP                                    &kp C_MUTE   &kp C_VOL_DN  &kp C_VOL_UP  &none            &kp PAUSE_BREAK
// ├─────────────────┼─────────────┼────────────┼────────────┼────────────┼────────────╮   ╭─────────────┼────────────┼─────────────┼─────────────┼────────────────┼────────────────┤
     &kp ES_EQUAL      &none         &none        &none        &none        &kp _HOME        &kp ES_LPAR   &kp KP_NUM   &kp KP_EQUAL  &kp KP_SLASH  &kp KP_MULTIPLY  &kp PSCRN
// ├─────────────────┼─────────────┼────────────┼────────────┼────────────┼────────────┤   ├─────────────┼────────────┼─────────────┼─────────────┼────────────────┼────────────────┤
     &kp TAB           &none         &none        &kp UP       &none        &kp _END         &kp ES_RPAR   &kp KP_N7    &kp KP_N8     &kp KP_N9     &kp KP_MINUS     &kp SLCK
// ├─────────────────┼─────────────┼────────────┼────────────┼────────────┼────────────┤   ├─────────────┼────────────┼─────────────┼─────────────┼────────────────┼────────────────┤
     &kp ESC           &none         &kp LEFT     &kp DOWN     &kp RIGHT    &kp PG_UP        &kp ES_PRCNT  &kp KP_N4    &kp KP_N5     &kp KP_N6     &kp KP_PLUS      &none
// ├─────────────────┼─────────────┼────────────┼────────────┼────────────┼────────────┤   ├─────────────┼────────────┼─────────────┼─────────────┼────────────────┼────────────────┤
     &ES_GRAVE_UNDEAD  &kp K_APP     &none        &kp F11      &kp F12      &kp PG_DN    ,   &kp ES_COMMA  &kp KP_N1    &kp KP_N2     &kp KP_N3     &kp KP_ENTER     &kp PG_UP
// ├─────────────────┼─────────────┼────────────┼────────────┼────────────┼────────────╯   ╰─────────────┼────────────┼─────────────┼─────────────┼────────────────┼────────────────┤
     &magic MAGIC 0    &kp CAPS      &kp INS      &kp F11      &kp F12                   ,                 &kp KP_N0    &kp KP_N0     &kp KP_DOT    &kp KP_ENTER     &kp PG_DN
// ╰─────────────────┴─────────────┴────────────┴────────────┴────────────╯                              ╰────────────┴─────────────┴─────────────┴────────────────┴────────────────╯
                                                                                         ,
//                                           ╭────────────┬────────────┬────────────╮         ╭────────────┬────────────┬────────────╮
                                               &tog FN      &none        &none                  &none        &none        &none
/*                                           ├────────────┼────────────┼────────────┤ */ , /* ├────────────┼────────────┼────────────┤ */
                                               &tog NAV     &tog NUM     &tog LOWER             &tog LOWER   &tog MOUSE   &tog SYM
//                                           ╰────────────┴────────────┴────────────╯         ╰────────────┴────────────┴────────────╯
)

GLV80_LAYER(Magic,
// ╭────────────┬────────────────┬────────────────┬────────────────┬────────────────╮                                 ╭────────────┬────────────┬────────────┬────────────┬───────────────╮
     &bt BT_CLR   &none            &none            &none            &none                                              &none        &none        &none        &none        &bt BT_CLR_ALL
// ├────────────┼────────────────┼────────────────┼────────────────┼────────────────┼────────────────╮   ╭────────────┼────────────┼────────────┼────────────┼────────────┼───────────────┤
     &to DEF      &to NAV          &to NUM          &to FN           &to SYM          &to MOUSE            &to LOWER    &to MAGIC    &none        &none        &none        &none
// ├────────────┼────────────────┼────────────────┼────────────────┼────────────────┼────────────────┤   ├────────────┼────────────┼────────────┼────────────┼────────────┼───────────────┤
     &none        &rgb_ug RGB_SPI  &rgb_ug RGB_SAI  &rgb_ug RGB_HUI  &rgb_ug RGB_BRI  &rgb_ug RGB_TOG      &none        &none        &none        &none        &none        &none
// ├────────────┼────────────────┼────────────────┼────────────────┼────────────────┼────────────────┤   ├────────────┼────────────┼────────────┼────────────┼────────────┼───────────────┤
     &bootloader  &rgb_ug RGB_SPD  &rgb_ug RGB_SAD  &rgb_ug RGB_HUD  &rgb_ug RGB_BRD  &rgb_ug RGB_EFF      &none        &none        &none        &none        &none        &bootloader
// ├────────────┼────────────────┼────────────────┼────────────────┼────────────────┼────────────────┤   ├────────────┼────────────┼────────────┼────────────┼────────────┼───────────────┤
     &sys_reset   &none            &none            &none            &none            &none            ,   &none        &none        &none        &none        &none        &sys_reset 
// ├────────────┼────────────────┼────────────────┼────────────────┼────────────────┼────────────────╯   ╰────────────┼────────────┼────────────┼────────────┼────────────┼───────────────┤
     &none        &none            &none            &none            &none                             ,                &none        &none        &none        &none        &none
// ╰────────────┴────────────────┴────────────────┴────────────────┴────────────────╯                                 ╰────────────┴────────────┴────────────┴────────────┴───────────────╯
                                                                                                       ,
//                                                         ╭────────────┬────────────┬─────────────╮         ╭────────────┬────────────┬────────────╮
                                                             &bt_2        &bt_3        &none                   &none        &none        &none
/*                                                         ├────────────┼────────────┼─────────────┤ */ , /* ├────────────┼────────────┼────────────┤ */
                                                             &bt_0        &bt_1        &out OUT_USB            &none        &none        &none
//                                                         ╰────────────┴────────────┴─────────────╯         ╰────────────┴────────────┴────────────╯
)

// GLV80_LAYER(label,
// // ╭────────────┬────────────┬────────────┬────────────┬────────────╮                             ╭────────────┬────────────┬────────────┬────────────┬────────────╮
//      XXX          XXX          XXX          XXX          XXX                                        XXX          XXX          XXX          XXX          XXX
// // ├────────────┼────────────┼────────────┼────────────┼────────────┼────────────╮   ╭────────────┼────────────┼────────────┼────────────┼────────────┼────────────┤
//      XXX          XXX          XXX          XXX          XXX          XXX              XXX          XXX          XXX          XXX          XXX          XXX
// // ├────────────┼────────────┼────────────┼────────────┼────────────┼────────────┤   ├────────────┼────────────┼────────────┼────────────┼────────────┼────────────┤
//      XXX          XXX          XXX          XXX          XXX          XXX              XXX          XXX          XXX          XXX          XXX          XXX
// // ├────────────┼────────────┼────────────┼────────────┼────────────┼────────────┤   ├────────────┼────────────┼────────────┼────────────┼────────────┼────────────┤
//      XXX          XXX          XXX          XXX          XXX          XXX              XXX          XXX          XXX          XXX          XXX          XXX
// // ├────────────┼────────────┼────────────┼────────────┼────────────┼────────────┤   ├────────────┼────────────┼────────────┼────────────┼────────────┼────────────┤
//      XXX          XXX          XXX          XXX          XXX          XXX          ,   XXX          XXX          XXX          XXX          XXX          XXX
// // ├────────────┼────────────┼────────────┼────────────┼────────────┼────────────╯   ╰────────────┼────────────┼────────────┼────────────┼────────────┼────────────┤
//      XXX          XXX          XXX          XXX          XXX                       ,                XXX          XXX          XXX          XXX          XXX
// // ╰────────────┴────────────┴────────────┴────────────┴────────────╯                             ╰────────────┴────────────┴────────────┴────────────┴────────────╯
//                                                                                    ,
// //                                     ╭────────────┬────────────┬────────────╮         ╭────────────┬────────────┬────────────╮
//                                          XXX          XXX          XXX                    XXX          XXX          XXX
// /*                                     ├────────────┼────────────┼────────────┤ */ , /* ├────────────┼────────────┼────────────┤ */
//                                          XXX          XXX          XXX                    XXX          XXX          XXX
// //                                     ╰────────────┴────────────┴────────────╯         ╰────────────┴────────────┴────────────╯
// )
